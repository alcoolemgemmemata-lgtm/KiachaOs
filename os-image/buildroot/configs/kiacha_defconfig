## os-image/buildroot/configs/kiacha_defconfig
```kconfig
BR2_x86_64=y
BR2_TOOLCHAIN_BUILDROOT_GLIBC=y
BR2_ROOTFS_DEVICE_CREATION_DYNAMIC_EUDEV=y
BR2_TARGET_GENERIC_ROOT_PASSWD="kiacha"
BR2_SYSTEM_ENABLE_NLS=y
BR2_PACKAGE_ALSA_UTILS=y
BR2_PACKAGE_ALSA_UTILS_AMIXER=y
BR2_PACKAGE_BUSYBOX_SHOW_OTHERS=y
BR2_PACKAGE_SYSTEMD=y
BR2_TARGET_ROOTFS_EXT2_4=y
BR2_TARGET_ROOTFS_EXT2_SIZE="2G"
BR2_LINUX_KERNEL=y
BR2_LINUX_KERNEL_CUSTOM_VERSION=y
BR2_LINUX_KERNEL_CUSTOM_VERSION_VALUE="6.9"
BR2_LINUX_KERNEL_DEFCONFIG="x86_64"
BR2_PACKAGE_GRUB2=y
BR2_PACKAGE_GRUB2_X86_64_EFI=y
BR2_ROOTFS_POST_BUILD_SCRIPT="board/kiacha/post-build.sh"
BR2_ROOTFS_POST_IMAGE_SCRIPT="board/kiacha/post-image.sh"
BR2_ROOTFS_OVERLAY="overlay"
```
